## conf/layer.conf
```bitbake
# Copyright (c) 2026 Nagesh Sonwane <nagesh.sonwane@hotmail.com>

BBPATH .= ":${LAYERDIR}"

BBFILES += "${LAYERDIR}/recipes-*/*/*.bb \
            ${LAYERDIR}/recipes-*/*/*.bbappend"

BBFILE_COLLECTIONS += "bbb-bsp"
BBFILE_PATTERN_bbb-bsp := "^${LAYERDIR}/"
BBFILE_PRIORITY_bbb-bsp = "7"

LAYERDEPENDS_bbb-bsp = "core arm-toolchain meta-arm meta-ti-bsp meta-beagle"
LAYERSERIES_COMPAT_bbb-bsp = "scarthgap"
```
